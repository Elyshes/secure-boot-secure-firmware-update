/*###ICF### Set of symbols used in SE and SB_SFU projects ****/

/* Slots must be aligned on sectors */

/* Swap Area (256 kbytes) => must be at least the maximum sector size of 128kbyte */
define exported symbol  __ICFEDIT_SWAP_start__ = 0x08040000;
define exported symbol  __ICFEDIT_SWAP_end__   = 0x0807FFFF;

/* Active slot #1 (768 kbytes) */
define exported symbol  __ICFEDIT_SLOT_Active_1_start__ = 0x08080000;
define exported symbol  __ICFEDIT_SLOT_Active_1_end__   = 0x0813FFFF;
define exported symbol  __ICFEDIT_SLOT_Active_1_header__= __ICFEDIT_SLOT_Active_1_start__;

/* Download slot #1 (768 kbytes) */
define exported symbol  __ICFEDIT_SLOT_Dwl_1_start__= 0x08140000;
define exported symbol  __ICFEDIT_SLOT_Dwl_1_end__  = 0x081FFFFF;


/* Slots not configured */
define exported symbol  __ICFEDIT_SLOT_Active_2_header__= 0x00000000;
define exported symbol  __ICFEDIT_SLOT_Active_2_start__ = 0x00000000;
define exported symbol  __ICFEDIT_SLOT_Active_2_end__   = 0x00000000;
define exported symbol  __ICFEDIT_SLOT_Active_3_header__= 0x00000000;
define exported symbol  __ICFEDIT_SLOT_Active_3_start__ = 0x00000000;
define exported symbol  __ICFEDIT_SLOT_Active_3_end__   = 0x00000000;
define exported symbol  __ICFEDIT_SLOT_Dwl_2_start__    = 0x00000000;
define exported symbol  __ICFEDIT_SLOT_Dwl_2_end__      = 0x00000000;
define exported symbol  __ICFEDIT_SLOT_Dwl_3_start__    = 0x00000000;
define exported symbol  __ICFEDIT_SLOT_Dwl_3_end__      = 0x00000000;

